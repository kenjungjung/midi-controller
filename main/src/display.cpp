#include "display.h"
#include "config.h"
#include "esp_log.h"
#include <cstdio>
#include <cstring>

static const char* TAG = "Display";

// IBM CP437 8x8 font, row-major (bit7=leftmost pixel), ASCII 0x20-0x7E
static const uint8_t k_font8x8[][8] = {
    {0x00,0x00,0x00,0x00,0x00,0x00,0x00,0x00}, // ' '
    {0x18,0x3C,0x3C,0x18,0x18,0x00,0x18,0x00}, // '!'
    {0x6C,0x6C,0x00,0x00,0x00,0x00,0x00,0x00}, // '"'
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    {0x76,0xDC,0x00,0x00,0x00,0x00,0x00,0x00}, // '~'
};

// ---------------------------------------------------------------------------

Display::Display()
{
    mutex_ = xSemaphoreCreateMutex();

    for (int i = 0; i < LINES; i++) {
        memset(log_[i], ' ', COLS);
        log_[i][COLS] = '\0';
    }

    i2c_master_bus_config_t bus_cfg = {};
    bus_cfg.i2c_port             = I2C_NUM_0;
    bus_cfg.sda_io_num           = PIN_OLED_SDA;
    bus_cfg.scl_io_num           = PIN_OLED_SCL;
    bus_cfg.clk_source           = I2C_CLK_SRC_DEFAULT;
    bus_cfg.glitch_ignore_cnt    = 7;
    bus_cfg.flags.enable_internal_pullup = true;
    ESP_ERROR_CHECK(i2c_new_master_bus(&bus_cfg, &bus_));

    i2c_device_config_t dev_cfg = {};
    dev_cfg.dev_addr_length = I2C_ADDR_BIT_LEN_7;
    dev_cfg.device_address  = 0x3C;
    dev_cfg.scl_speed_hz    = 400000;
    ESP_ERROR_CHECK(i2c_master_bus_add_device(bus_, &dev_cfg, &dev_));

    // SSD1306 init sequence
    send_cmd(0xAE);
    send_cmd(0xD5); send_cmd(0x80);
    send_cmd(0xA8); send_cmd(0x3F);
    send_cmd(0xD3); send_cmd(0x00);
    send_cmd(0x40);
    send_cmd(0x8D); send_cmd(0x14);
    send_cmd(0x20); send_cmd(0x00);
    send_cmd(0xA1);
    send_cmd(0xC8);
    send_cmd(0xDA); send_cmd(0x12);
    send_cmd(0x81); send_cmd(0xCF);
    send_cmd(0xD9); send_cmd(0xF1);
    send_cmd(0xDB); send_cmd(0x40);
    send_cmd(0xA4);
    send_cmd(0xA6);
    send_cmd(0xAF);

    uint8_t blank[128] = {};
    for (uint8_t page = 0; page < 8; page++) {
        set_cursor(0, page);
        send_data(blank, sizeof(blank));
    }

    ESP_LOGI(TAG, "SSD1306 initialized");
    draw_line(0, TITLE);
}

Display::~Display()
{
    if (dev_)   i2c_master_bus_rm_device(dev_);
    if (bus_)   i2c_del_master_bus(bus_);
    if (mutex_) vSemaphoreDelete(mutex_);
}

void Display::send_cmd(uint8_t cmd)
{
    uint8_t buf[2] = {0x00, cmd};
    i2c_master_transmit(dev_, buf, sizeof(buf), 50);
}

void Display::send_data(const uint8_t* data, size_t len)
{
    uint8_t buf[129];
    buf[0] = 0x40;
    memcpy(buf + 1, data, len);
    i2c_master_transmit(dev_, buf, len + 1, 100);
}

void Display::set_cursor(uint8_t col, uint8_t page)
{
    send_cmd(0xB0 | (page & 0x07));
    send_cmd(0x00 | (col & 0x0F));
    send_cmd(0x10 | (col >> 4));
}

void Display::draw_line(uint8_t page, const char* str)
{
    set_cursor(0, page);
    uint8_t pixels[128] = {};
    for (int i = 0; i < COLS; i++) {
        uint8_t ch = static_cast<uint8_t>(str[i]);
        if (ch < 0x20 || ch > 0x7E) ch = 0x20;
        const uint8_t* glyph = k_font8x8[ch - 0x20];
        for (int c = 0; c < 8; c++) {
            uint8_t col_byte = 0;
            for (int row = 0; row < 8; row++)
                if (glyph[row] & (0x80 >> c))
                    col_byte |= (1 << row);
            pixels[i * 8 + c] = col_byte;
        }
    }
    send_data(pixels, sizeof(pixels));
}

std::array<char, Display::COLS + 1> Display::format_event(const MidiEvent& ev, bool outgoing)
{
    std::array<char, Display::COLS + 1> out{};
    const char* dir = outgoing ? "OUT" : "IN ";
    switch (ev.type) {
        case MidiEvent::Type::CC:
            snprintf(out.data(), out.size(), "%s CC%3d %3d", dir, ev.number, ev.value);
            break;
        case MidiEvent::Type::NOTE_ON:
            snprintf(out.data(), out.size(), "%s N %3d ON", dir, ev.number);
            break;
        case MidiEvent::Type::NOTE_OFF:
            snprintf(out.data(), out.size(), "%s N %3d OFF",dir, ev.number);
            break;
    }
    return out;
}

void Display::push_event(const MidiEvent& ev, bool outgoing)
{
    auto line = format_event(ev, outgoing);

    xSemaphoreTake(mutex_, portMAX_DELAY);
    memcpy(log_[head_], line.data(), COLS + 1);
    head_  = (head_ + 1) % LINES;
    dirty_ = true;
    xSemaphoreGive(mutex_);
}

void Display::render()
{
    xSemaphoreTake(mutex_, portMAX_DELAY);
    if (!dirty_) {
        xSemaphoreGive(mutex_);
        return;
    }
    char snapshot[LINES][COLS + 1];
    for (int i = 0; i < LINES; i++) {
        int idx = (head_ - 1 - i + LINES) % LINES;
        memcpy(snapshot[i], log_[idx], COLS + 1);
    }
    dirty_ = false;
    xSemaphoreGive(mutex_);

    for (int i = 0; i < LINES; i++)
        draw_line(i + 1, snapshot[i]);
}
