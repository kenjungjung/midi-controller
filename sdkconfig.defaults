## sdkconfig.defaults
```kconfig
# TinyUSB MIDI
CONFIG_TINYUSB_MIDI_COUNT=1
CONFIG_TINYUSB_DESC_MANUFACTURER_STRING="kenjung MIDI"
CONFIG_TINYUSB_DESC_PRODUCT_STRING="kenjung MIDI"
CONFIG_TINYUSB_DESC_SERIAL_STRING=""
CONFIG_TINYUSB_DESC_CDC_STRING=""
```
